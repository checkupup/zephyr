## subsys/logging/backends/Kconfig.adsp_mtrace
```kconfig
# Copyright (c) 2021 Nordic Semiconductor ASA
# SPDX-License-Identifier: Apache-2.0

config LOG_BACKEND_ADSP_MTRACE
	bool "Intel ADSP mtrace backend"
	depends on SOC_FAMILY_INTEL_ADSP
	select LOG_BACKEND_SUPPORTS_FORMAT_TIMESTAMP
	help
	  Provide a logging backend which writes to SRAM window
	  using the SOF Linux driver mtrace buffer layout.

if LOG_BACKEND_ADSP_MTRACE

backend = ADSP_MTRACE
backend-str = adsp_mtrace
source "subsys/logging/Kconfig.template.log_format_config"

config LOG_MULTI_SLOT
	bool "Use separate debug window slot per core for mtrace logging"
	depends on SMP
	depends on INTEL_ADSP_DEBUG_SLOT_MANAGER
	depends on LOG_CORE_ID_PREFIX
	help
	  When enabled, each CPU core gets its own debug window slot for
	  mtrace logging. This allows the host to read per-core log data
	  from separate memory window slots.

endif # LOG_BACKEND_ADSP_MTRACE

config MTRACE_LOG_CACHE_BUF_SIZE
	int "Number of bytes dedicated for the mtrace log cache buffer"
	depends on LOG_BACKEND_ADSP_MTRACE
	default 0
	range 0 32768
	help
	  Number of bytes dedicated for the mtrace log cache buffer.

	  Only used when the value is larger than the debug window slot size,
	  otherwise log data is written to the slot directly.

config MTRACE_LOG_CACHE_DRAIN_PERIOD_MS
	int "mtrace log cache buffer drain period"
	depends on LOG_BACKEND_ADSP_MTRACE
	default 1
	range 1 10
	help
	  Period, in milliseconds, at which the mtrace backend retries moving
	  data from its internal cache buffer into the debug window slot.
	  The slot has room again only after the host has consumed it, which
	  happens independently of the DSP log activity. Without a periodic
	  drain the cached data would only be pushed when new log output
	  arrives, so the tail of a burst would stay in the cache indefinitely
	  and never reach the host.
```
